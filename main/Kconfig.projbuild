## main/Kconfig.projbuild
```kconfig
menu "Oscilloscope"
    config DISPLAY_PIN_MOSI
        int "Display SPI MOSI pin"
        default 23

    config DISPLAY_PIN_SCK
        int "Display SPI clock pin"
        default 18

    config DISPLAY_PIN_DC
        int "Display SPI data command pin"
        default 5

    config DISPLAY_SPI_FREQ_MHZ
        int "Display SPI clock frequency (MHz)"
        default 20

    config ADC_PIN_SDA
        int "ADC I2C SDA pin"
        default 21

    config ADC_PIN_SCL
        int "ADC I2C SCL pin"
        default 22

    config ADC_PIN_ALERT
        int "ADC alert pin"
        default 4

    config ADC_I2C_FREQ_KHZ
        int "ACD I2C clock frequency (kHz)"
        default 400

    config ADC_I2C_DEVICE_ADDRESS
        int "ADC I2c device address"
        default 69

    config ENCODER_PIN_A
        int "Rotary encoder pin 1"
        default 17

    config ENCODER_PIN_B
        int "Rotary encoder pin 2"
        default 16

    config ENCODER_PIN_PRESS
        int "Rotary encoder button pin"
        default 15

endmenu
```
